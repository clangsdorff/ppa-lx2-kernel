## drivers/contexthub/inputhub_as/device/Kconfig
```kconfig
config CONTEXTHUB_DEVICE_DEMO
        bool "CONTEXTHUB_DEVICE_DEMO"
        depends on INPUTHUB_AS
        default n
        help
        support CONTEXTHUB_DEVICE_DEMO.
```

## drivers/contexthub/inputhub_as/sensor_channel/Kconfig
```kconfig
config SENSOR_CHANNEL
	bool "SENSOR_CHANNEL"
	depends on INPUTHUB_AS
	help
	support SENSOR_CHANNEL.
```
